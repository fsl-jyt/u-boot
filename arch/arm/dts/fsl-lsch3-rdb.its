## arch/arm/dts/fsl-lsch3-rdb.its
```
/*
 * Copyright (C) 2016, Freescale Semiconductor
 *
 * Abhimanyu Saini <abhimanyu.saini@nxp.com>
 *
 * This file is licensed under the terms of the GNU General Public
 * License version 2.  This program is licensed "as is" without any
 * warranty of any kind, whether express or implied.
 */

/dts-v1/;

/ {
	description = "Flattened Device Tree blob";
	#address-cells = <1>;

	images {
		ls2088a@1 {
			description = "Flattened Device Tree blob";
			data = /incbin/("./fsl-ls2088a-rdb.dtb");
			type = "flat_dt";
			arch = "arm64";
			compression = "none";
		};
		ls2080a@1 {
			description = "Flattened Device Tree blob";
			data = /incbin/("./fsl-ls2080a-rdb.dtb");
			type = "flat_dt";
			arch = "arm64";
			compression = "none";
		};
	};
};
```

## configs/ls1088aemu_defconfig
```kconfig
CONFIG_ARM=y
CONFIG_TARGET_LS1088ARDB=y
# CONFIG_SYS_MALLOC_F is not set
CONFIG_FIT=y
CONFIG_FIT_VERBOSE=y
CONFIG_OF_BOARD_SETUP=y
CONFIG_OF_STDOUT_VIA_ALIAS=y
CONFIG_SYS_EXTRA_OPTIONS="LS1088A, EMU, SYS_FSL_DDR4"
CONFIG_BOOTDELAY=10
CONFIG_HUSH_PARSER=y
CONFIG_CMD_GREPENV=y
CONFIG_CMD_I2C=y
# CONFIG_CMD_SETEXPR is not set
CONFIG_CMD_DHCP=y
CONFIG_CMD_MII=y
CONFIG_CMD_PING=y
CONFIG_CMD_CACHE=y
CONFIG_CMD_EXT2=y
CONFIG_CMD_FAT=y
CONFIG_NET_RANDOM_ETHADDR=y
CONFIG_NETDEVICES=y
CONFIG_E1000=y
CONFIG_SYS_NS16550=y
```

## configs/ls1088ardb_defconfig
```kconfig
CONFIG_ARM=y
CONFIG_TARGET_LS1088ARDB=y
CONFIG_SYS_EXTRA_OPTIONS="SYS_FSL_DDR4, LS1088A"
CONFIG_NET_RANDOM_ETHADDR=y
CONFIG_NETDEVICES=y
CONFIG_E1000=y
CONFIG_SYS_NS16550=y
```
